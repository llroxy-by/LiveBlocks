## firmware/sdkconfig.defaults
```kconfig
# LB-034 固件骨架的默认 sdkconfig（只影响编译，不做任何烧写决策）。
CONFIG_IDF_TARGET="esp32c3"

# 4 MB Flash、单 app 分区：骨架不落盘任何东西。
CONFIG_ESPTOOLPY_FLASHSIZE="4MB"
CONFIG_PARTITION_TABLE_SINGLE_APP=y

# 控制台 UART0 / 115200：与协议帧共用同一条串口（限制见 docs/FIRMWARE.md §8）。
CONFIG_ESP_CONSOLE_UART_DEFAULT=y
CONFIG_ESP_CONSOLE_UART_BAUDRATE=115200

# 骨架用不到 WiFi / 蓝牙：编译更快、镜像更小。
CONFIG_BT_ENABLED=n

# 主任务栈够放启动日志与分发占位。
CONFIG_ESP_MAIN_TASK_STACK_SIZE=4096
```
